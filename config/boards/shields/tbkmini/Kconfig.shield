## config/boards/shields/tbkmini/Kconfig.shield
```kconfig
# Copyright (c) 2021 Casey Webster
# SPDX-License-Identifier: MIT

config SHIELD_TBKMINI_LEFT
    def_bool $(shields_list_contains,tbkmini_left)

config SHIELD_TBKMINI_RIGHT
    def_bool $(shields_list_contains,tbkmini_right)

config SHIELD_NANO_OLED
	def_bool $(shields_list_contains,nano_oled)
```

## config/west.yml
```yaml
manifest:
  remotes:
    - name: zmkfirmware-infused-kim
      url-base: https://github.com/infused-kim
    - name: zephyr-dododo
      url-base: https://github.com/bobobo1618
  projects:
    - name: zmk
      remote: zephyr-dododo #zmkfirmware-infused-kim
      revision: fix-oled #my-changes/oled-ext-pwr
      import: app/west.yml
  self:
    path: config
```
